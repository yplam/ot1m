## applications/at_server/Kconfig
```kconfig
config APP_AT_MODEM
    bool "enable app at modem module"
    default n

config APP_MODEM_EN_PIN
    bool "enable app at modem module"
    default n

config APP_LWM2M
    bool "enable app lwm2m module"
    default n

config APP_COAP
    bool "enable app coap module"
    default n

config APP_TESTING
    bool "enable app testing"
    default n

config APP_AT_DEV_NAME
	string "Device Name of UART Device for AT Command"
	default "UART_0"

config APP_AT_DEV_ALWAYS_ON
    bool "AT UART not enter low power mode"
    default n

config APP_AT_CMD_MAX_LEN
	int "AT CMD MAX SIZE"
	default 512

config APP_AT_RESPONSE_MAX_LEN
	int "AT RESPONSE MAX SIZE"
	default 512


config APP_AT_MAX_PARAM
    int "AT CMD MAX PARAM"
	default 10


source "Kconfig.zephyr"
```

## boards/arm/e0102_nrf52840/Kconfig.board
```kconfig
config BOARD_E0102_NRF52840
	bool "nRF52840 E0102 NRF52840"
	depends on SOC_NRF52840_QIAA
```

## boards/arm/e0102_nrf52840/Kconfig.defconfig
```kconfig
if BOARD_E0102_NRF52840

config BOARD
	default "e0102_nrf52840"

if USB

config USB_NRFX
	default y

config USB_DEVICE_STACK
	default y

endif # USB

config IEEE802154_NRF5
	default y
	depends on IEEE802154

config BT_CTLR
	default BT

endif # BOARD_NRF52840OT1M_NRF52840
```

## boards/arm/ot1m_display_nrf52840/Kconfig.board
```kconfig
# NRF52840OT1M NRF52840 board configuration

config BOARD_OT1M_DISPLAY_NRF52840
	bool "nRF52840 OT1M Display NRF52840"
	depends on SOC_NRF52840_QIAA
```

## boards/arm/ot1m_display_nrf52840/ot1m_display_nrf52840_defconfig
```kconfig
# SPDX-License-Identifier: Apache-2.0

CONFIG_SOC_SERIES_NRF52X=y
CONFIG_SOC_NRF52840_QIAA=y
CONFIG_BOARD_OT1M_DISPLAY_NRF52840=y

# Enable MPU
CONFIG_ARM_MPU=y

# Enable RTT
CONFIG_USE_SEGGER_RTT=y

# enable GPIO
CONFIG_GPIO=y

# enable uart driver
CONFIG_SERIAL=n

# enable console
CONFIG_CONSOLE=n
CONFIG_UART_CONSOLE=n

# additional board options
CONFIG_GPIO_AS_PINRESET=y
```

## boards/arm/ot1m_evm_nrf52840/Kconfig.board
```kconfig
# OT1M NRF52840 board configuration

config BOARD_OT1M_EVM_NRF52840
	bool "OT1M EVM NRF52840"
	depends on SOC_NRF52840_QIAA
```

## boards/arm/ot1m_evm_nrf52840/Kconfig.defconfig
```kconfig
# OT1M EVM NRF52840 board configuration

# SPDX-License-Identifier: Apache-2.0

if BOARD_OT1M_EVM_NRF52840

config BOARD
	default "ot1m_evm_nrf52840"

if USB

config USB_NRFX
	default y

config USB_DEVICE_STACK
	default y

# Enable UART driver, needed for CDC ACM
config SERIAL
	default USB_CDC_ACM

config UART_INTERRUPT_DRIVEN
	default USB_CDC_ACM
	
endif # USB

config IEEE802154_NRF5
	default y
	depends on IEEE802154

config BT_CTLR
	default BT

endif # BOARD_OT1M_EVM_NRF52840
```

## boards/arm/ot1m_nrf52840/Kconfig
```kconfig
# OT1M NRF52840 board configuration

config BOARD_ENABLE_DCDC
	bool "Enable DCDC mode"
	select SOC_DCDC_NRF52X
	default n
	depends on BOARD_OT1M_NRF52840
```

## boards/arm/ot1m_nrf52840/Kconfig.board
```kconfig
# OT1M NRF52840 board configuration

config BOARD_OT1M_NRF52840
	bool "OT1M NRF52840"
	depends on SOC_NRF52840_QIAA
```

## boards/arm/ot1m_nrf52840/Kconfig.defconfig
```kconfig
# nRF52840 OT1M NRF52840 board configuration
#
# Copyright (c) 2018 Nordic Semiconductor ASA
#
# SPDX-License-Identifier: Apache-2.0

if BOARD_OT1M_NRF52840

config BOARD
	default "ot1m_nrf52840"

if USB

config USB_NRFX
	default y

config USB_DEVICE_STACK
	default y

# Enable UART driver, needed for CDC ACM
config SERIAL
	default USB_CDC_ACM

config UART_INTERRUPT_DRIVEN
	default USB_CDC_ACM

endif # USB

config BT_CTLR
	default BT

endif # BOARD_OT1M_NRF52840
```

## boards/arm/ot1m_sensor_nrf52840/Kconfig.board
```kconfig
# nRF52840 Dongle NRF52840 board configuration

# Copyright (c) 2018 Nordic Semiconductor ASA
# SPDX-License-Identifier: Apache-2.0

config BOARD_OT1M_SENSOR_NRF52840
	bool "nRF52840 OT1M SENSOR NRF52840"
	depends on SOC_NRF52840_QIAA
```

## boards/arm/ot1m_sensor_nrf52840/Kconfig.defconfig
```kconfig
# nRF52840 Dongle NRF52840 board configuration
#
# Copyright (c) 2018 Nordic Semiconductor ASA
#
# SPDX-License-Identifier: Apache-2.0

if BOARD_OT1M_SENSOR_NRF52840

config BOARD
	default "ot1m_sensor_nrf52840"

# To let the nRF5 bootloader load an application, the application
# must be linked after Nordic MBR, that is factory-programmed on the board.

# Nordic nRF5 booatloader exists outside of the partitions specified in the
# DTS file, so we manually override FLASH_LOAD_OFFEST to link the application
# correctly, after Nordic MBR.

# When building MCUBoot, MCUBoot itself will select USE_DT_CODE_PARTITION
# which will make it link into the correct partition specified in DTS file,
# so no override is necessary.

config FLASH_LOAD_OFFSET
	default 0x1000
	depends on BOARD_HAS_NRF5_BOOTLOADER && !USE_DT_CODE_PARTITION

if USB_DEVICE_STACK

# Enable UART driver, needed for CDC ACM
config SERIAL
	default y

endif # USB_DEVICE_STACK

config BT_CTLR
	default BT

endif # BOARD_OT1M_SENSOR_NRF52840
```

## drivers/Kconfig
```kconfig
# drivers configuration options

# Copyright (c) 2015 Intel Corporation
# SPDX-License-Identifier: Apache-2.0

menu "App Device Drivers"

rsource "display/Kconfig"
rsource "senseair_s8/Kconfig"

endmenu
```

## drivers/display/Kconfig
```kconfig
config WAVESHARE_4IN2
	bool "WAVESHARE_4IN2 compatible display controller driver"
	depends on SPI
	help
	  Enable driver for WAVESHARE_4IN2 compatible controller.
```

## lib/Kconfig
```kconfig
#

# Copyright (c) 2018 Nordic Semiconductor ASA
#

# SPDX-License-Identifier: LicenseRef-BSD-5-Clause-Nordic
#

menu "Libraries"

rsource "coap/Kconfig"
rsource "openthread/Kconfig"
rsource "settings/Kconfig"
rsource "lwm2m/Kconfig"
rsource "sht30d/Kconfig"
rsource "button/Kconfig"
rsource "display/Kconfig"
rsource "sensor/Kconfig"

endmenu
```

## lib/button/Kconfig
```kconfig
#
# Copyright (c) 2018 Nordic Semiconductor
#
# SPDX-License-Identifier: LicenseRef-BSD-5-Clause-Nordic
#

menu "App BUTTON Configure"

config APP_BUTTON
	bool "App button"

endmenu
```

## lib/coap/Kconfig
```kconfig
#
# Copyright (c) 2018 Nordic Semiconductor
#
# SPDX-License-Identifier: LicenseRef-BSD-5-Clause-Nordic
#

menu "App COAP Configure"

config APP_COAP
	bool "App COAP client"
	select APP_OPENTHREAD
	select COAP

config APP_MAX_COAP_MSG_LEN
	int "AT COAP MAX SIZE"
	default 256

endmenu
```

## lib/display/Kconfig
```kconfig
#
# Copyright (c) 2018 Nordic Semiconductor
#
# SPDX-License-Identifier: LicenseRef-BSD-5-Clause-Nordic
#

menu "App Display Configure"

config APP_DISPLAY
	bool "App Display Configure"
    select SPI
    select SPI_ASYNC
    select DISPLAY
    select WAVESHARE_4IN2
    select CHARACTER_FRAMEBUFFER

endmenu
```

## lib/lwm2m/Kconfig
```kconfig
#
# Copyright (c) 2018 Nordic Semiconductor
#
# SPDX-License-Identifier: LicenseRef-BSD-5-Clause-Nordic
#

config APP_LWM2M
	bool "App LWM2M Configure"
    select LWM2M
    select LWM2M_IPSO_SUPPORT
    select LWM2M_IPSO_TEMP_SENSOR
    select LWM2M_IPSO_LIGHT_CONTROL
    select LWM2M_IPSO_TIMER
	select APP_SETTINGS
	select APP_OPENTHREAD
```

## lib/openthread/Kconfig
```kconfig
#
# Copyright (c) 2018 Nordic Semiconductor
#
# SPDX-License-Identifier: LicenseRef-BSD-5-Clause-Nordic
#

menu "App OpenThread Configure"

config APP_OPENTHREAD
	bool "App OpenThread Configure"
	select APP_SETTINGS

if	APP_OPENTHREAD

config APP_OPENTHREAD_AUTO_START
    bool "Auto Start Saved Network"
    default y

config APP_OPENTHREAD_CHILD_TIMEOUT
    int "Openthread SED child timeout"
    default 240

config APP_OPENTHREAD_ACTIVE_POLL_PERIOD
    int "Openthread SED active poll period"
    default 200

config APP_OPENTHREAD_SLEEPY_POLL_PERIOD
    int "Openthread SED sleepy poll period"
    default 30000

endif
endmenu
```

## lib/sensor/Kconfig
```kconfig
#
# Copyright (c) 2018 Nordic Semiconductor
#
# SPDX-License-Identifier: LicenseRef-BSD-5-Clause-Nordic
#

config APP_SENSOR
	bool "App SENSOR"
	default n
	select I2C
    select SENSOR
    select SHT3XD
```

## lib/settings/Kconfig
```kconfig
#
# Copyright (c) 2018 Nordic Semiconductor
#
# SPDX-License-Identifier: LicenseRef-BSD-5-Clause-Nordic
#

menu "App Settings Lib"

config APP_SETTINGS
	bool "App Settings Lib"

endmenu
```

## lib/sht30d/Kconfig
```kconfig
#
# Copyright (c) 2018 Nordic Semiconductor
#
# SPDX-License-Identifier: LicenseRef-BSD-5-Clause-Nordic
#

config APP_SHT30D
	bool "App SHT30D"
	default n
	select I2C
```
