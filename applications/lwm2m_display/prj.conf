## CMakeLists.txt
```
# SPDX-License-Identifier: Apache-2.0

cmake_minimum_required(VERSION 3.13.1)

set(BOARD ot1m_display_nrf52840)

#if (NOT CMAKE_BUILD_TYPE)
#    set(CMAKE_BUILD_TYPE ZDebug)
#endif()
# Point to the build type-specific config file
# set(CONF_FILE "prj.conf overlay-ot.conf overlay-dtls.conf")
set(CONF_FILE "prj.conf overlay-ot.conf")

find_package(Zephyr HINTS $ENV{ZEPHYR_BASE})

include_directories(${CMAKE_SOURCE_DIR}/build/zephyr/include/generated)

file(STRINGS
        ${CMAKE_SOURCE_DIR}/build/zephyr/include/generated/autoconf.h
        LIST_OF_CONFIGS
        REGEX "^#define CONFIG_"
        ENCODING "UTF-8"
        )
foreach (CONFIG ${LIST_OF_CONFIGS})
    string(REPLACE " " ";" CONFIG_ITEM_LIST ${CONFIG})
    list(GET CONFIG_ITEM_LIST 1 CONFIG_ITEM_NAME)
    list(GET CONFIG_ITEM_LIST 2 CONFIG_ITEM_VALUE)
#    message(${CONFIG_ITEM_NAME})
#    message(${CONFIG_ITEM_VALUE})
    add_definitions('-D${CONFIG_ITEM_NAME}=${CONFIG_ITEM_VALUE}')
    set(${CONFIG_ITEM_NAME} ${CONFIG_ITEM_VALUE})
endforeach()

include_directories(${ZEPHYR_BASE}/subsys/net/ip ../../../modules/lib/openthread/include)


project(lwm2m_display)
target_sources(app PRIVATE src/main.c src/bat.c src/lwm2m_display.c src/app_display.c)

target_include_directories(app PRIVATE ${CMAKE_SOURCE_DIR}/src)
```

## prj.conf
```kconfig
# 通用配置
CONFIG_GPIO=y
CONFIG_NRFX_GPIOTE=n
CONFIG_CONSOLE=n
CONFIG_SHELL_BACKENDS=n
CONFIG_UART_CONSOLE=n
CONFIG_SERIAL=n

CONFIG_BOOT_BANNER=n
CONFIG_LOG=y
CONFIG_BOOTLOADER_MCUBOOT=n
CONFIG_SYS_POWER_MANAGEMENT=y
CONFIG_DEVICE_POWER_MANAGEMENT=y
CONFIG_PRINTK=y

CONFIG_POLL=y
CONFIG_LOG_STRDUP_BUF_COUNT=8
# CONFIG_REBOOT=y
CONFIG_LOG_BACKEND_UART=n
CONFIG_LOG_BACKEND_RTT=y
CONFIG_LOG_DEFAULT_LEVEL=3
CONFIG_SENSOR_LOG_LEVEL_DBG=n
CONFIG_RING_BUFFER=y

CONFIG_SYS_POWER_MANAGEMENT=y
CONFIG_DEVICE_POWER_MANAGEMENT=y

# Kernel options
CONFIG_MAIN_STACK_SIZE=2048
CONFIG_ENTROPY_GENERATOR=y
CONFIG_TEST_RANDOM_GENERATOR=y
CONFIG_INIT_STACKS=y
CONFIG_HEAP_MEM_POOL_SIZE=32768

CONFIG_NEWLIB_LIBC=y
CONFIG_NEWLIB_LIBC_FLOAT_PRINTF=y
CONFIG_CBPRINTF_FP_SUPPORT=y
CONFIG_SYSTEM_WORKQUEUE_STACK_SIZE=2048
CONFIG_SHELL_STACK_SIZE=3072


CONFIG_NETWORKING=y
CONFIG_NET_IPV6=y
CONFIG_NET_IF_UNICAST_IPV6_ADDR_COUNT=3
CONFIG_NET_IF_MCAST_IPV6_ADDR_COUNT=2
CONFIG_NET_IPV4=n
CONFIG_NET_DHCPV4=n
CONFIG_NET_IF_UNICAST_IPV4_ADDR_COUNT=3
CONFIG_NET_IF_MCAST_IPV4_ADDR_COUNT=2
CONFIG_NET_PKT_RX_COUNT=10
CONFIG_NET_PKT_TX_COUNT=10
CONFIG_NET_BUF_RX_COUNT=10
CONFIG_NET_BUF_TX_COUNT=10
CONFIG_NET_MAX_CONTEXTS=5

CONFIG_NET_CONFIG_NEED_IPV6=y
CONFIG_NET_CONFIG_NEED_IPV4=y
CONFIG_NET_CONFIG_SETTINGS=y

CONFIG_APP_DISPLAY=y
CONFIG_APP_SENSOR=y
CONFIG_APP_SETTINGS=y
CONFIG_APP_LWM2M=y

CONFIG_ADC=y
CONFIG_ADC_ASYNC=y
CONFIG_ADC_NRFX_SAADC=y

CONFIG_LWM2M_IPSO_HUMIDITY_SENSOR_INSTANCE_COUNT=2
CONFIG_LWM2M_IPSO_TEMP_SENSOR_INSTANCE_COUNT=2
CONFIG_LWM2M_IPSO_GENERIC_SENSOR_INSTANCE_COUNT=2

CONFIG_LWM2M_PEER_PORT=5683

# CONFIG_LWM2M_LOG_LEVEL_DBG=y
#
#
# CONFIG_LIS2DH=y
#
# CONFIG_FLASH=y
# CONFIG_NORDIC_QSPI_NOR=y
# CONFIG_FLASH_LOG_LEVEL_DBG=n
```

## prj-old.conf
```kconfig
# 通用配置
CONFIG_GPIO=y
CONFIG_NRFX_GPIOTE=n
CONFIG_CONSOLE=n
CONFIG_SHELL_BACKENDS=n
CONFIG_UART_CONSOLE=n
CONFIG_SERIAL=n

CONFIG_I2C=n
CONFIG_I2C_LOG_LEVEL_DBG=n
CONFIG_LWM2M_LOG_LEVEL_DBG=y
CONFIG_DISPLAY_LOG_LEVEL_DBG=n

CONFIG_APP_BUTTON=n
CONFIG_APP_LWM2M=n
CONFIG_APP_OPENTHREAD=y
CONFIG_APP_SETTINGS=y
CONFIG_APP_DISPLAY=y
# CONFIG_APP_SHT30D=y

CONFIG_LOG=y
CONFIG_BOOTLOADER_MCUBOOT=n
CONFIG_SYS_POWER_MANAGEMENT=y
CONFIG_DEVICE_POWER_MANAGEMENT=y

CONFIG_POLL=y
# CONFIG_REBOOT=y
CONFIG_LOG_BACKEND_UART=n
CONFIG_LOG_BACKEND_RTT=y
CONFIG_LOG_DEFAULT_LEVEL=3
CONFIG_SENSOR_LOG_LEVEL_DBG=n
CONFIG_RING_BUFFER=y

CONFIG_SETTINGS=y
CONFIG_NVS=y
CONFIG_SETTINGS_NVS=y
CONFIG_SYS_POWER_MANAGEMENT=y
CONFIG_DEVICE_POWER_MANAGEMENT=y

# Kernel options
CONFIG_MAIN_STACK_SIZE=2048
CONFIG_ENTROPY_GENERATOR=y
CONFIG_TEST_RANDOM_GENERATOR=y
CONFIG_INIT_STACKS=y

CONFIG_NEWLIB_LIBC=y
CONFIG_NEWLIB_LIBC_FLOAT_PRINTF=y

# Generic networking options
CONFIG_NETWORKING=y
CONFIG_NET_UDP=y
CONFIG_NET_TCP=n
CONFIG_NET_IPV6=y
CONFIG_NET_IPV4=n
CONFIG_NET_SOCKETS=y
CONFIG_NET_SOCKETS_POSIX_NAMES=y
CONFIG_NET_SOCKETS_POLL_MAX=4
CONFIG_NET_CONNECTION_MANAGER=y

# Kernel options
CONFIG_MAIN_STACK_SIZE=2048
CONFIG_ENTROPY_GENERATOR=y
CONFIG_TEST_RANDOM_GENERATOR=y
CONFIG_INIT_STACKS=y
CONFIG_HEAP_MEM_POOL_SIZE=32768

# Logging
CONFIG_NET_LOG=y
CONFIG_LOG_STRDUP_BUF_COUNT=10
CONFIG_NET_STATISTICS=y
CONFIG_PRINTK=y

# Network buffers
CONFIG_NET_PKT_RX_COUNT=16
CONFIG_NET_PKT_TX_COUNT=16
CONFIG_NET_BUF_RX_COUNT=80
CONFIG_NET_BUF_TX_COUNT=80
CONFIG_NET_CONTEXT_NET_PKT_POOL=y

# IP address options
CONFIG_NET_IF_UNICAST_IPV6_ADDR_COUNT=3
CONFIG_NET_IF_MCAST_IPV6_ADDR_COUNT=4
CONFIG_NET_MAX_CONTEXTS=10

# Network shell
CONFIG_NET_SHELL=n

# The addresses are selected so that qemu<->qemu connectivity works ok.
# For linux<->qemu connectivity, create a new conf file and swap the
# addresses (so that peer address is ending to 2).
CONFIG_NET_CONFIG_SETTINGS=y
CONFIG_NET_CONFIG_NEED_IPV6=y

CONFIG_NEWLIB_LIBC=y

CONFIG_NET_IPV6_NBR_CACHE=n
CONFIG_NET_IPV6_MLD=n
CONFIG_NET_CONFIG_NEED_IPV4=n

CONFIG_SYSTEM_WORKQUEUE_STACK_SIZE=2048
CONFIG_SHELL_STACK_SIZE=3072

CONFIG_NET_L2_OPENTHREAD=y

CONFIG_OPENTHREAD_DEBUG=y
CONFIG_OPENTHREAD_L2_DEBUG=y
CONFIG_OPENTHREAD_L2_LOG_LEVEL_INF=y
# CONFIG_OPENTHREAD_L2_LOG_LEVEL_DBG=y
CONFIG_OPENTHREAD_CHANNEL=26

# mbedTLS tweaks
CONFIG_MBEDTLS_SSL_MAX_CONTENT_LEN=768

# A sample configuration to enable Thread Joiner, uncomment if needed
CONFIG_OPENTHREAD_JOINER=y
#CONFIG_OPENTHREAD_JOINER_AUTOSTART=y

# Enable diagnostic module, uncomment if needed
#CONFIG_OPENTHREAD_DIAG=yAPP_MAX_COAP_MSG_LEN

CONFIG_OPENTHREAD_MANUAL_START=y
CONFIG_OPENTHREAD_SHELL=n
CONFIG_OPENTHREAD_SLAAC=y
CONFIG_OPENTHREAD_MTD=y

CONFIG_APP_OPENTHREAD_SLEEPY_POLL_PERIOD=100
CONFIG_APP_OPENTHREAD_JOINER_PSKD="J01NME"

CONFIG_LWM2M=y
CONFIG_LWM2M_COAP_BLOCK_SIZE=512
CONFIG_LWM2M_IPSO_SUPPORT=y
CONFIG_LWM2M_IPSO_TEMP_SENSOR=y
CONFIG_LWM2M_IPSO_HUMIDITY_SENSOR=y
CONFIG_LWM2M_IPSO_PRESSURE_SENSOR=n
CONFIG_LWM2M_IPSO_LIGHT_CONTROL=n
CONFIG_LWM2M_IPSO_GENERIC_SENSOR=y
CONFIG_LWM2M_IPSO_GENERIC_SENSOR_TYPE="Generic_Sensor"
CONFIG_LWM2M_IPSO_GENERIC_SENSOR_INSTANCE_COUNT=4
CONFIG_LWM2M_IPSO_TIMER=y
CONFIG_LWM2M_IPSO_ONOFF_SWITCH=n
CONFIG_LWM2M_IPSO_PUSH_BUTTON=n
CONFIG_LWM2M_IPSO_ACCELEROMETER=n
CONFIG_LWM2M_IPSO_BUZZER=n
# 超时时间
CONFIG_LWM2M_ENGINE_DEFAULT_LIFETIME=50
# 超时前提前多少update，防止网络慢的原因导致超时
CONFIG_LWM2M_SECONDS_TO_UPDATE_EARLY=20

############# DTLS
CONFIG_LWM2M_DTLS_SUPPORT=y
CONFIG_LWM2M_PEER_PORT=5684

# Select Zephyr mbedtls
CONFIG_MBEDTLS=y

# Special MbedTLS changes
CONFIG_MBEDTLS_ENABLE_HEAP=y
# 需要足够大才能同时运行openthread join与lwm2m
CONFIG_MBEDTLS_HEAP_SIZE=65536
CONFIG_MBEDTLS_SSL_MAX_CONTENT_LEN=1500
CONFIG_MBEDTLS_CIPHER_CCM_ENABLED=y

# Disable RSA, we don't parse certs: saves flash/memory
# 如果开启了需要调整配置
CONFIG_MBEDTLS_KEY_EXCHANGE_RSA_ENABLED=n
# Enable PSK instead
CONFIG_MBEDTLS_KEY_EXCHANGE_PSK_ENABLED=y

CONFIG_NET_SOCKETS_SOCKOPT_TLS=y
CONFIG_NET_SOCKETS_TLS_MAX_CONTEXTS=4
CONFIG_NET_SOCKETS_ENABLE_DTLS=y



CONFIG_SPI=y
CONFIG_SPI_ASYNC=y

CONFIG_DISPLAY=y
CONFIG_WAVESHARE_4IN2=y

CONFIG_CHARACTER_FRAMEBUFFER=y


CONFIG_I2C=y
CONFIG_SENSOR=y
CONFIG_SHT3XD=y
CONFIG_CBPRINTF_FP_SUPPORT=y

CONFIG_LIS2DH=y

CONFIG_FLASH=y
CONFIG_NORDIC_QSPI_NOR=y
CONFIG_FLASH_LOG_LEVEL_DBG=n
```

## src/main.c
```c
/*
 * main 线程，进行公共的初始化操作，然后启动其他线程
 */

#include <zephyr.h>
#include <logging/log.h>
LOG_MODULE_REGISTER(main, LOG_LEVEL_INF);
#include <device.h>
#include <drivers/sensor.h>
#include <stdio.h>
#include <devicetree.h>
#include <drivers/gpio.h>
#include <pm/pm.h>
#include <math.h>
#include "app_settings.h"
#include "app_display.h"
#include "app_sensor.h"
#include "app_openthread.h"
#include <net/openthread.h>
#include <openthread/link.h>
#include <openthread/thread.h>
#include <openthread/ping_sender.h>
#include <app_lwm2m.h>
#include "bat.h"
//#include <drivers/flash.h>


#define FLASH_DEVICE DT_LABEL(DT_INST(0, nordic_qspi_nor))
#define FLASH_NAME "JEDEC QSPI-NOR"
#define FLASH_TEST_REGION_OFFSET 0xff000
#define FLASH_SECTOR_SIZE        4096

static struct k_work ping_work;
static struct k_work lwm2m_work;
static struct k_work_delayable bat_work;

static bool serverFound=false;
static otIp6Address lwm2mServer;

struct k_poll_event events[1];

struct float32_value outdoor_temp, outdoor_humi;

void printIp6Address(const otIp6Address * addr){
    char buf[40];
    net_addr_ntop(AF_INET6, addr, buf, 40);
    LOG_INF("+IPADDR:%s", log_strdup(buf));
}

void handlePingReply(const otPingSenderReply *aReply, void *aContext) {
    LOG_INF("ping response");
    printIp6Address(&aReply->mSenderAddress);
    if(serverFound == false){
        lwm2mServer = aReply->mSenderAddress;
        serverFound = true;
        k_work_submit(&lwm2m_work);
    }
}

void sendPing(struct k_work *work) {
    otError  error        = OT_ERROR_NONE;
    otInstance * instance = openthread_get_default_instance();
    __ASSERT(instance, "OT instance is NULL");
    otPingSenderConfig config;
    memset(&config, 0, sizeof(config));
    LOG_INF("sending ping");
    error = otIp6AddressFromString("ff03::fd", &config.mDestination);
    if(error != OT_ERROR_NONE){
        LOG_ERR("parse address error");
    }
    config.mReplyCallback      = handlePingReply;
    config.mCount = 4;
    otPingSenderPing(instance, &config);
}

void processBatAdc(struct k_work *work) {
    LOG_INF("read bat");
    bat_val_read();
    k_work_schedule(&bat_work, K_SECONDS(120));
}

static void *temperature_get_buf(uint16_t obj_inst_id, uint16_t res_id,
                                 uint16_t res_inst_id, size_t *data_len)
{
    struct float32_value *v = (struct float32_value *) app_sensor_get_value(0);
    /* echo the value back through the engine to update min/max values */
    lwm2m_engine_set_float32("3303/0/5700", v);
    *data_len = sizeof(v);
    return v;
}

static void *humidity_get_buf(uint16_t obj_inst_id, uint16_t res_id,
                                 uint16_t res_inst_id, size_t *data_len)
{
    struct float32_value *v = (struct float32_value *) app_sensor_get_value(1);
    /* echo the value back through the engine to update min/max values */
    lwm2m_engine_set_float32("3304/0/5700", v);
    *data_len = sizeof(v);
    return v;
}

static void *outdoor_temperature_get_buf(uint16_t obj_inst_id, uint16_t res_id,
                                 uint16_t res_inst_id, size_t *data_len)
{
    *data_len = sizeof(outdoor_temp);
    return &outdoor_temp;
}

static void *outdoor_humidity_get_buf(uint16_t obj_inst_id, uint16_t res_id,
                              uint16_t res_inst_id, size_t *data_len)
{
    *data_len = sizeof(outdoor_humi);
    return &outdoor_humi;
}

static void *lwm2m_pre_write(uint16_t obj_inst_id, uint16_t res_id,
                             uint16_t res_inst_id, size_t *data_len)
{
    LOG_INF("pre write %d, %d", obj_inst_id, res_id);
    *data_len = sizeof(outdoor_temp);
    return &outdoor_temp;
}

static int lwm2m_post_write (uint16_t obj_inst_id,
                             uint16_t res_id, uint16_t res_inst_id,
                             uint8_t *data, uint16_t data_len,
                             bool last_block, size_t total_size)
{
    LOG_INF("post write %d, %d", obj_inst_id, res_id);
    return 0;
}


void startLWM2M(struct k_work *work) {
    if(!(app_ot_is_connected() && serverFound)) {
        return ;
    }
    LOG_INF("connecting lwm2m");
    int pos = 0;
    int ret=0;
    char buf[40];
    otExtAddress extAddress;
    otInstance * instance = openthread_get_default_instance();
    __ASSERT(instance, "OT instance is NULL");

    LOG_INF("connecting to lwm2m server:");
    printIp6Address(&lwm2mServer);
    app_lwm2m_settings lwm2m_settings = {
            .psk_id = {0x00},
            .psk_key = {
                    0x00, 0x01, 0x02, 0x03, 0x04, 0x05, 0x06, 0x07,
                    0x08, 0x09, 0x0a, 0x0b, 0x0c, 0x0d, 0x0e, 0x0f
            },
            .psk_key_length = 16,
#if defined(CONFIG_LWM2M_DTLS_SUPPORT)
            .enable_psk = 1U,
#else
            .enable_psk = 0U,
#endif
            .server_addr = {0x00},
            .server_is_bootstrap = false,
    };
    net_addr_ntop(AF_INET6, &lwm2mServer, lwm2m_settings.server_addr, NET_IPV6_ADDR_LEN);
    otLinkGetFactoryAssignedIeeeEui64(instance, &extAddress);
    pos = 0;
    for(int i=0; i<OT_EXT_ADDRESS_SIZE; i++){
        pos += sprintf(&buf[pos], "%02x", extAddress.m8[i]);
    }
    buf[pos] = '\0';
    memcpy(lwm2m_settings.psk_id, buf, pos);
    (void)lwm2m_engine_create_obj_inst("3303/0");
    (void)lwm2m_engine_create_obj_inst("3304/0");
    (void)lwm2m_engine_create_obj_inst("32769/0");
//    lwm2m_engine_register_pre_write_callback("32769/0/26241", lwm2m_pre_write);
    lwm2m_engine_register_read_callback("3303/0/5700", temperature_get_buf);
    lwm2m_engine_register_read_callback("3304/0/5700", humidity_get_buf);
//    lwm2m_engine_register_read_callback("3304/1/5700", outdoor_humidity_get_buf);
    k_msleep(1000);
    ret = app_lwm2m_client_setup(&lwm2m_settings);
    if(ret !=0){
        LOG_ERR("lwmwm setup error %d", ret);
    } else {
        app_lwm2m_client_start();
    }
}

void main(void) {
    LOG_INF("OT1M Starting...");
    int ret;
    app_init_settings();

    k_work_init(&ping_work, sendPing);
    k_work_init(&lwm2m_work, startLWM2M);
    k_work_init_delayable(&bat_work, processBatAdc);

    bat_init();
    if(bat_is_charge()){
        LOG_INF("bat is charge");
    }
    if(bat_is_standby()){
        LOG_INF("bat is standby");
    }
    int val = bat_val_read();
    k_work_schedule(&bat_work, K_SECONDS(120));
    app_display_init();
    LOG_INF("bat is %d", val);


    for(int i=0; i< 10; i++){
        if(app_ot_is_connected()){
            LOG_INF("thread network connected");
            break;
        }
        k_sleep(K_MSEC(3000));
    }
    if(!app_ot_is_connected()){
        app_ot_start_join();
        for(int i=0; i< 10; i++){
            if(app_ot_is_connected()){
                LOG_INF("join thread network");
                break;
            }
            k_sleep(K_MSEC(3000));
        }
    }
    otInstance * instance = openthread_get_default_instance();
    otError  error        = OT_ERROR_NONE;
    __ASSERT(instance, "OT instance is NULL");
    const otNetifAddress *unicastAddrs = otIp6GetUnicastAddresses(instance);
    for (const otNetifAddress *addr = unicastAddrs; addr; addr = addr->mNext)
    {
        printIp6Address(&addr->mAddress);
    }
    LOG_INF("start ping");
    k_work_submit(&ping_work);

    k_poll_event_init(&events[0],
                      K_POLL_TYPE_SEM_AVAILABLE,
                      K_POLL_MODE_NOTIFY_ONLY,
                      app_sensor_get_sem());
    struct float32_value * sensor_val;
    while (true) {
        ret = k_poll(events, 1, K_FOREVER);
        if (events[0].state == K_POLL_STATE_SEM_AVAILABLE) {
            k_sem_take(events[0].sem, K_NO_WAIT);
            if(app_lwm2m_get_status() == APP_LWM2M_CONNECT) {
                sensor_val = (struct float32_value *) app_sensor_get_value(0);
                LOG_INF("temp %d, %d", sensor_val->val1, sensor_val->val2);
                lwm2m_engine_set_float32("3303/0/5700", (struct float32_value *) app_sensor_get_value(0));
                lwm2m_engine_set_float32("3304/0/5700", (struct float32_value *) app_sensor_get_value(1));
            }
            app_display_update();
            events[0].state = K_POLL_STATE_NOT_READY;
        }
    }
}


//    const struct device *flash_dev;
//    flash_dev = device_get_binding(FLASH_DEVICE);
//
//    if (!flash_dev) {
//        LOG_WRN("SPI flash driver %s was not found!\n",
//               FLASH_DEVICE);
//        return;
//    }
//    LOG_INF("\nTest 1: Flash erase\n");
//    flash_write_protection_set(flash_dev, false);
//
//    ret = flash_erase(flash_dev, FLASH_TEST_REGION_OFFSET,
//                     FLASH_SECTOR_SIZE);
//    if (ret != 0) {
//        LOG_WRN("Flash erase failed! %d\n", ret);
//    } else {
//        LOG_INF("Flash erase succeeded!\n");
//    }



//    const struct device *dev = device_get_binding("LIS3DH");
//    int rc;
//
//    if (dev == NULL) {
//        LOG_WRN("Could not get LIS3DH device\n");
//        return;
//    }
//
//    while (true) {
//        struct sensor_value x, y, z;
//
//        rc = sensor_sample_fetch(dev);
//        if (rc == 0) {
//            rc = sensor_channel_get(dev, SENSOR_CHAN_ACCEL_X,
//                                    &x);
//        }
//        if (rc == 0) {
//            rc = sensor_channel_get(dev, SENSOR_CHAN_ACCEL_Y,
//                                    &y);
//        }
//        if (rc == 0) {
//            rc = sensor_channel_get(dev, SENSOR_CHAN_ACCEL_Z,
//                                    &z);
//        }
//        if (rc != 0) {
//            LOG_INF("SHT3XD: failed: %d\n", rc);
//            break;
//        }
//        LOG_INF("x: %d, %d, y: %d, %d, z: %d, %d", x.val1, x.val2, y.val1, y.val2, z.val1, z.val2);
//
//        k_sleep(K_MSEC(2000));
//    }
```

## src/app_display.c
```c
#include <zephyr.h>
#include <logging/log.h>

LOG_MODULE_REGISTER(app_display, LOG_LEVEL_INF);

#include <device.h>
#include <drivers/sensor.h>
#include <stdio.h>
#include <devicetree.h>
#include <drivers/display.h>
#include <app_sensor.h>
#include <net/lwm2m.h>
#include <app_lwm2m.h>
#include "epdpaint.h"
#include "app_display.h"
#include "bat.h"

const struct device *display_dev;

Paint paint;
#define COLORED      1
#define UNCOLORED    0

void app_display_update(void) {
    uint8_t buff[50];
    int ret;
    struct float32_value sensor_val;
    LOG_INF("display update");
    const char *sensorNames[] = {"Indoor", "Outdoor", "PM2.5", "GM"};
    Paint_Clear(&paint, UNCOLORED);
//        Paint_DrawHorizontalLine(&paint, 2, 185, 248, COLORED);
    Paint_DrawVerticalLine(&paint, 250, 2, 296, COLORED);

    for (int i = 0; i < 4; i++) {
        if (i > 0) {
            Paint_DrawHorizontalLine(&paint, 250, 75 * i, 148, COLORED);
        }
        Paint_DrawStringAt(&paint, 255, 75 * i + 5, sensorNames[i], &Font815, COLORED);
    }

    if(app_lwm2m_get_status() == APP_LWM2M_CONNECT){
        if (0 == lwm2m_engine_get_float32("3303/0/5700", &sensor_val)) {
            ret = sprintf(buff, "%d", (int)sensor_val.val1);
            buff[ret] = '\0';
            Paint_DrawStringAt(&paint, 270, 30, buff, &Font1632, COLORED);
            ret = sprintf(buff, "%d", (int)sensor_val.val2 / 100000);
            buff[ret] = '\0';
            Paint_DrawStringAt(&paint, 303, 45, buff, &Font815, COLORED);
            Paint_DrawCircle(&paint, 306, 41, 2, COLORED);
            Paint_DrawCircle(&paint, 306, 41, 3, COLORED);
        }
        if (0 == lwm2m_engine_get_float32("3304/0/5700", &sensor_val)) {
            ret = sprintf(buff, "%d%%", (int) sensor_val.val1);
            buff[ret] = '\0';
            Paint_DrawStringAt(&paint, 340, 30, buff, &Font1632, COLORED);
        }
        if (0 == lwm2m_engine_get_float32("32769/0/26241", &sensor_val)) {
            LOG_INF("sensor outdoor %d, %d", (int)sensor_val.val1, (int)sensor_val.val2);
            ret = sprintf(buff, "%d", (int)sensor_val.val1);
            buff[ret] = '\0';
            Paint_DrawStringAt(&paint, 270, 30+75, buff, &Font1632, COLORED);
            ret = sprintf(buff, "%d", (int)sensor_val.val2 / 100000);
            buff[ret] = '\0';
            Paint_DrawStringAt(&paint, 303, 45+75, buff, &Font815, COLORED);
            Paint_DrawCircle(&paint, 306, 41+75, 2, COLORED);
            Paint_DrawCircle(&paint, 306, 41+75, 3, COLORED);
        }
    }

//    if (0 == lwm2m_engine_get_float32("3303/1/5700", &sensor_val)) {
//        ret = sprintf(buff, "%d", (int)sensor_val.val1);
//        buff[ret] = '\0';
//        Paint_DrawStringAt(&paint, 270, 30+75, buff, &Font1632, COLORED);
//        ret = sprintf(buff, "%d", (int)sensor_val.val2 / 100000);
//        buff[ret] = '\0';
//        Paint_DrawStringAt(&paint, 303, 45+75, buff, &Font815, COLORED);
//        Paint_DrawCircle(&paint, 306, 41+75, 2, COLORED);
//        Paint_DrawCircle(&paint, 306, 41+75, 3, COLORED);
//    }
//    if (0 == lwm2m_engine_get_float32("3304/1/5700", &sensor_val)) {
//        ret = sprintf(buff, "%d%%", (int) sensor_val.val1);
//        buff[ret] = '\0';
//        Paint_DrawStringAt(&paint, 340, 30+75, buff, &Font1632, COLORED);
//    }




    int bat = (int)get_bat_val();
    LOG_INF("bat %d", bat);
    buff[0] = ' ';
    buff[1] = '\0';
    if(!bat_is_charge()){
        int vm100 = (bat*600/4096);
        if(vm100 >= 400) {
            buff[0] += 5;
        } else if (vm100 >= 387) {
            buff[0] += 4;
        } else if (vm100 >= 379) {
            buff[0] += 3;
        } else if (vm100 >= 370) {
            buff[0] += 2;
        } else {
            buff[0] += 1;
        }
    }
    Paint_DrawStringAt(&paint, 380, 0, buff, &FontICON, COLORED);

    display_blanking_off(display_dev);
    k_sleep(K_MSEC(10000));
}
void app_display_init(void) {

    LOG_INF("starting display");
    display_dev = device_get_binding("WaveShare_4IN2");

    if (display_dev == NULL) {
        LOG_ERR("device not found.  Aborting test.");
        return;
    }
    Paint_Init(&paint, display_get_framebuffer(display_dev), 400, 300);


}
```

## src/app_display.h
```c
#ifndef APP_DISPLAY_H
#define APP_DISPLAY_H

#include <drivers/sensor.h>
void app_display_init(void);
void app_display_update(void);
#endif //APP_DISPLAY_H
```

## src/bat.c
```c
//
// Created by yplam on 14/12/2021.
//

#include <zephyr.h>
#include <logging/log.h>
LOG_MODULE_REGISTER(bat, LOG_LEVEL_INF);
#include <device.h>
#include <devicetree.h>
#include <drivers/gpio.h>
#include "bat.h"

#include <drivers/adc.h>
#include <hal/nrf_saadc.h>

#define ADC_DEVICE_NAME		DT_LABEL(DT_NODELABEL(adc))
#define ADC_RESOLUTION		12
#define ADC_OVERSAMPLING	4 /* 2^ADC_OVERSAMPLING samples are averaged */
#define ADC_MAX 		4096
#define ADC_GAIN		ADC_GAIN_1_5
#define ADC_REFERENCE		ADC_REF_INTERNAL
#define ADC_REF_INTERNAL_MV	600UL
#define ADC_ACQUISITION_TIME	ADC_ACQ_TIME(ADC_ACQ_TIME_MICROSECONDS, 10)
#define ADC_CHANNEL_ID		0
#define ADC_CHANNEL_INPUT	NRF_SAADC_INPUT_AIN4

static const struct device *gpio0_dev, *gpio1_dev, *adc_dev;

static int16_t channel_0_data;  // This will hold the adc result

bool bat_is_charge(void) {
    return !gpio_pin_get(gpio1_dev, 11);
}

bool bat_is_standby(void) {
    return !gpio_pin_get(gpio1_dev, 10);
}

int16_t get_bat_val(void) {
    return channel_0_data;
}

static int init_adc(void)
{
    adc_dev = device_get_binding(ADC_DEVICE_NAME);
    if (!adc_dev) {
        LOG_ERR("Cannot get ADC device");
        return -ENXIO;
    }

    static const struct adc_channel_cfg channel_cfg = {
            .gain             = ADC_GAIN,
            .reference        = ADC_REFERENCE,
            .acquisition_time = ADC_ACQUISITION_TIME,
            .channel_id       = ADC_CHANNEL_ID,
#if defined(CONFIG_ADC_CONFIGURABLE_INPUTS)
            .input_positive   = ADC_CHANNEL_INPUT,
#endif
    };
    int err = adc_channel_setup(adc_dev, &channel_cfg);
    if (err) {
        LOG_ERR("Setting up the ADC channel failed");
        return err;
    }

    return 0;
}


int bat_val_read(void)
{
    int ret;
    struct adc_sequence sequence = {
            /* This is a bitmask that tells the driver which channels to convert : bit n = 1 for channel n */
            .channels    = (1 << 0),
            /* Where will the data be stored (could be an array if there are multiple channels to convert */
            .buffer      = &channel_0_data,
            /* buffer size in bytes, not number of samples */
            .buffer_size = sizeof(channel_0_data),
            /* 12 bit resolution */
            .resolution  = ADC_RESOLUTION,
            /* nulls for the rest of the fields */
            .options = NULL,
            .calibrate = 0,
            .oversampling = ADC_OVERSAMPLING,
    };
    ret = adc_read(adc_dev, &sequence);
    return channel_0_data;
}
void bat_init(void) {
    gpio0_dev = device_get_binding(DT_LABEL(DT_NODELABEL(gpio0)));
    if (!gpio0_dev) {
        LOG_ERR("Cannot get GPIO device");
    }

    gpio1_dev = device_get_binding(DT_LABEL(DT_NODELABEL(gpio1)));
    if (!gpio1_dev) {
        LOG_ERR("Cannot get GPI1 device");
    }

    int err = gpio_pin_configure(gpio1_dev,
                                 11,
                                 GPIO_INPUT | GPIO_PULL_UP);

    if (err) {
        LOG_ERR("Cannot configure charge pin");
    }

    err = gpio_pin_configure(gpio1_dev,
                                 10,
                                 GPIO_INPUT | GPIO_PULL_UP);

    if (err) {
        LOG_ERR("Cannot configure standby pin");
    }

    gpio_pin_configure(gpio0_dev,
                       3,
                       GPIO_OUTPUT);
    gpio_pin_set_raw(gpio0_dev,
                     3,
                     1);
    init_adc();
}
```

## src/bat.h
```c
//
// Created by yplam on 14/12/2021.
//

#ifndef LWM2M_DISPLAY_BAT_H
#define LWM2M_DISPLAY_BAT_H
#include <zephyr.h>

bool bat_is_charge(void);
bool bat_is_standby(void);
void bat_init(void);
int bat_val_read(void);
int16_t get_bat_val(void);
#endif //LWM2M_DISPLAY_BAT_H
```

## src/lwm2m_display.c
```c
//
// Created by yplam on 4/1/2022.
//

#include "lwm2m_display.h"
#include <zephyr.h>
#include <logging/log.h>

LOG_MODULE_REGISTER(lwm2m_display, LOG_LEVEL_INF);
#include <init.h>
#include "lwm2m_object.h"
#include "lwm2m_engine.h"
#include "lwm2m_resource_ids.h"

#define MAX_INSTANCE_COUNT 1

/* resource state variables */
static float32_value_t sensor_value[MAX_INSTANCE_COUNT];

static struct lwm2m_engine_obj display;
static struct lwm2m_engine_obj_field fields[] = {
        OBJ_FIELD_DATA(26241, RW, FLOAT),
};


static struct lwm2m_engine_obj_inst inst[MAX_INSTANCE_COUNT];
static struct lwm2m_engine_res res[MAX_INSTANCE_COUNT][1];
static struct lwm2m_engine_res_inst
        res_inst[MAX_INSTANCE_COUNT][1];


static int display_post_write_cb(uint16_t obj_inst_id,
                               uint16_t res_id, uint16_t res_inst_id,
                               uint8_t *data, uint16_t data_len,
                               bool last_block, size_t total_size)
{
    LOG_INF("write data");
    return 0;
}

static struct lwm2m_engine_obj_inst *display_create(uint16_t obj_inst_id)
{
    LOG_INF("create display");
    int index = 0, i = 0, j = 0;
    if(inst[index].obj){
        return NULL;
    }
    (void)memset(res[index], 0,
                 sizeof(res[index][0]) * ARRAY_SIZE(res[index]));
    init_res_instance(res_inst[index], ARRAY_SIZE(res_inst[index]));

    /* initialize instance resource data */
    INIT_OBJ_RES(26241, res[index], i,
                 res_inst[index], j, 1, false, true,
                 &sensor_value[index], sizeof(*sensor_value),
                 NULL, NULL, NULL, display_post_write_cb, NULL);
    inst[index].resources = res[index];
    inst[index].resource_count = i;
    LOG_INF("create display ok");
    return &inst[index];
}

static int lwm2m_display_init(const struct device *dev)
{
    display.obj_id = 32769;
    display.version_major = 1;
    display.version_minor = 0;
    display.is_core = false;
    display.fields = fields;
    display.field_count = ARRAY_SIZE(fields);
    display.max_instance_count = 1;
    display.create_cb = display_create;
    lwm2m_register_obj(&display);

    return 0;
}

SYS_INIT(lwm2m_display_init, APPLICATION, CONFIG_KERNEL_INIT_PRIORITY_DEFAULT);
```

## src/lwm2m_display.h
```c
//
// Created by yplam on 4/1/2022.
//

#ifndef LWM2M_DISPLAY_LWM2M_DISPLAY_H
#define LWM2M_DISPLAY_LWM2M_DISPLAY_H

#endif //LWM2M_DISPLAY_LWM2M_DISPLAY_H
```
